/**
 * @cliArgs --board "/ti/boards/CC1352P1_LAUNCHXL" --product "simplelink_cc13xx_cc26xx_sdk@5.30.01.01"
 * @versions {"tool":"1.15.0+2826"}
 */

/**
 * Import the modules used in this configuration.
 */
const CCFG     = scripting.addModule("/ti/devices/CCFG");
const ADC      = scripting.addModule("/ti/drivers/ADC", {}, false);
const ADC1     = ADC.addInstance();
const RF       = scripting.addModule("/ti/drivers/RF");
const RTOS     = scripting.addModule("/ti/drivers/RTOS");
const UART2    = scripting.addModule("/ti/drivers/UART2", {}, false);
const UART21   = UART2.addInstance();
const easylink = scripting.addModule("/ti/easylink/easylink");

/**
 * Write custom configuration values to the imported modules.
 */
CCFG.xoscCapArray       = true;
CCFG.xoscCapArrayDelta  = 0xC1;
CCFG.ccfgTemplate.$name = "ti_devices_CCFGTemplate0";

ADC1.$name                = "ADC_0";
ADC1.adcPinInstance.$name = "CONFIG_PIN_0";

RF.$hardware = system.deviceData.board.components["SKY13317-373LF"];

UART21.$name              = "UART0";
UART21.$hardware          = system.deviceData.board.components.XDS110UART;
UART21.uart.txPin.$assign = "boosterpack.4";
UART21.uart.rxPin.$assign = "boosterpack.3";

easylink.EasyLink_Phy_50kbps2gfsk                                  = true;
easylink.EasyLink_Phy_5kbpsSlLr                                    = true;
easylink.EasyLink_Phy_200kbps2gfsk                                 = true;
easylink.defaultPhy                                                = "EasyLink_Phy_5kbpsSlLr";
easylink.EasyLink_Phy_Custom                                       = false;
easylink.enableAddrFilter                                          = false;
easylink.radioConfigEasylinkPhy50kbps2gfsk.carrierFrequency        = 915.0000;
easylink.radioConfigEasylinkPhy50kbps2gfsk.codeExportConfig.$name  = "ti_devices_radioconfig_code_export_param1";
easylink.radioConfigEasylinkPhy5kbpssllr.carrierFrequency          = 915.0000;
easylink.radioConfigEasylinkPhy5kbpssllr.codeExportConfig.$name    = "ti_devices_radioconfig_code_export_param2";
easylink.radioConfigEasylinkPhy200kbps2gfsk.carrierFrequency       = 915.0000;
easylink.radioConfigEasylinkPhy200kbps2gfsk.codeExportConfig.$name = "ti_devices_radioconfig_code_export_param3";

/**
 * Pinmux solution for unlocked pins/peripherals. This ensures that minor changes to the automatic solver in a future
 * version of the tool will not impact the pinmux you originally saw.  These lines can be completely deleted in order to
 * re-solve from scratch.
 */
ADC1.adc.$suggestSolution         = "ADC0";
ADC1.adc.adcPin.$suggestSolution  = "boosterpack.2";
RF.rfAntennaPin0.$suggestSolution = "ball.41";
RF.rfAntennaPin1.$suggestSolution = "ball.42";
RF.rfAntennaPin2.$suggestSolution = "ball.43";
UART21.uart.$suggestSolution      = "UART0";
